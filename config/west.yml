## config/west.yml
```yaml
manifest:
  remotes:
    - name: zmkfirmware
      url-base: https://github.com/zmkfirmware
    - name: urob # ← 公開されている urob 氏のリポジトリを使用
      url-base: https://github.com/urob
  projects:
    - name: zmk
      remote: zmkfirmware
      revision: v0.3-branch
      import: app/west.yml
    - name: zmk-pmw3610-driver # ← これで公開リポジトリから取得可能
      remote: urob
      revision: main
  self:
    path: config
```
